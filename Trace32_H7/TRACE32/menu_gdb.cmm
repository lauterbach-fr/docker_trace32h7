DIALOG.OK "Please refer to README before fisrt start"

Do "~~/menu.cmm"
Do "~~/menu_demo_gdb.cmm"


