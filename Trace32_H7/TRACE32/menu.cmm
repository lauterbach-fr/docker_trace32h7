GLOBAL &psd
&psd=OS.PSD()

; ------------------------------------------------------------------------------

IF OS.NAME()=="Windows"
(
MENU.RESet
MENU.ReProgram
(
  ADD
  MENU
  (
    POPUP "Portenta H7"
    (
      MENUITEM "DEbug GDB"
      (
        Os.Command  """&psd"""\bin\windows64\t32marm.exe -c  """&psd"""\config\configGDB.t32 -s  """&psd"""\menu_gdb.cmm  
        quit 
      )

      POPUP "DEbug JTAG"
      (
          MENUITEM "Sieve"
          (
            Os.Command   """&psd"""\bin\windows64\t32marm.exe -c  """&psd"""\config\configJTAG.t32 -s   """&psd"""\demo\sieve\stm32h7_sieve_ram.cmm
          quit
          )
          MENUITEM "MultiBlinks"
          (
            Os.Command   """&psd"""\bin\windows64\t32marm.exe -c  """&psd"""\config\configJTAG.t32 -s   """&psd"""\demo\multiblinks\stm32h7_multiblinks_flash.cmm
          quit
          )
          MENUITEM "Zephyr"
          (
            Os.Command """&psd"""\bin\windows64\t32marm.exe -c  """&psd"""\config\configJTAG.t32 -s     """&psd"""\demo\zephyr\stm32h747_zephyr_flash.cmm
          quit
          )
      )

      POPUP "DEbug simulateur"
      (
        MENUITEM "Sieve"
        (
          Os.Command  """&psd"""\bin\windows64\t32marm.exe -c  """&psd"""\config\configSimu.t32 -s   """&psd"""\demo\sieve\stm32h7_sieve_sim.cmm
          quit
        )
        MENUITEM "Bug image"
        (
          Os.Command  """&psd"""\bin\windows64\t32marm.exe -c  """&psd"""\config\configSimu.t32 -s   """&psd"""\demo\sim.cmm 
          quit
        )
        
      )
    
    )
  )
  ADD
  TOOLBAR
  (
    TOOLITEM "Go main" ":stepover" 
    (
      SYStem.Up
      Go main
    )
  )
)
MENU.addtool "READE ME" ":group" "PEDIT &psd\..\README_WINDOWS.md"
MENU.addtool "Save" ":Camera" "DO &psd\demo\kernel\freertos\ramdump.cmm"

WELCOME.STARTUP
ENDDO
)

ELSE IF OS.NAME()=="Linux"
(
MENU.RESet
MENU.ReProgram
(
  ADD
  MENU
  (
    POPUP "Portenta H7"
    (
      MENUITEM "DEbug GDB"
      (
        Os.screen  """&psd"""/bin/pc_linux64/t32marm -c  """&psd"""/config/configGDB.t32 -s  """&psd"""/menu_gdb.cmm
        quit
      )
      POPUP "DEbug JTAG"
      (
          MENUITEM "Sieve"
          (
            Os.screen  """&psd"""/bin/pc_linux64/t32marm -c  """&psd"""/config/configJTAG.t32 -s   """&psd"""/demo/sieve/stm32h7_sieve_ram.cmm
            quit
          )
          MENUITEM "MultiBlinks"
          (
            Os.screen  """&psd"""/bin/pc_linux64/t32marm -c  """&psd"""/config/configJTAG.t32 -s   """&psd"""/demo/multiblinks/stm32h7_multiblinks_flash.cmm
            quit
          )
          MENUITEM "Zephyr"
          (
            Os.screen  """&psd"""/bin/pc_linux64/t32marm -c  """&psd"""/config/configJTAG.t32 -s   """&psd"""/demo/zephyr/stm32h747_zephyr_flash.cmm
            quit
          )
      )


      POPUP "DEbug simulateur"
      (
        MENUITEM "Bug image"
        (
          Os.Command  """&psd"""/bin/pc_linux64/t32marm -c  """&psd"""/config/configSimu.t32 -s   """&psd"""/demo/sieve/stm32h7_sieve_sim.cmm 
          quit
        )
        MENUITEM "Bug image"
        (
          Os.Command  """&psd"""/bin/pc_linux64/t32marm -c  """&psd"""/config/configSimu.t32 -s   """&psd"""/demo/sim.cmm 
          quit
        )
      )
    
    )
  )
  ADD
  TOOLBAR
  (
    TOOLITEM "Go main" ":stepover" 
    (
      SYStem.Up
      Go main
    )
  )
)
MENU.addtool "READE ME" ":group" "PEDIT &psd/../README_LINUX.md"
MENU.addtool "Save" ":Camera" "DO &psd/demo/kernel/freertos/ramdump.cmm"
WELCOME.STARTUP
ENDDO
)
